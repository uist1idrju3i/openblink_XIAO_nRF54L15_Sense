## CMakeLists.txt
```
# SPDX-License-Identifier: Apache-2.0

cmake_minimum_required(VERSION 3.20.0)
find_package(Zephyr REQUIRED HINTS $ENV{ZEPHYR_BASE})
project(OpenBlink)

target_sources(app PRIVATE
                    src/main.c
                    src/app/blink.c
                    src/app/comm.c
                    src/app/init.c
                    src/app/mrubyc_vm.c
                    src/app/storage.c
                    src/api/api.c
                    src/api/ble.c
                    src/api/blink.c
                    src/api/input.c
                    src/api/led.c
                    src/api/pixels.c
                    src/api/symbol.c
                    src/drv/ble.c
                    src/drv/ble_blink.c
                    src/drv/gpio.c
                    src/drv/led_strip.c
                    src/lib/mrubyc/hal.c
                    mrubyc/src/alloc.c
                    mrubyc/src/c_array.c
                    mrubyc/src/c_hash.c
                    mrubyc/src/c_math.c
                    mrubyc/src/c_numeric.c
                    mrubyc/src/c_object.c
                    mrubyc/src/c_proc.c
                    mrubyc/src/c_range.c
                    mrubyc/src/c_string.c
                    mrubyc/src/class.c
                    mrubyc/src/console.c
                    mrubyc/src/error.c
                    mrubyc/src/global.c
                    mrubyc/src/keyvalue.c
                    mrubyc/src/load.c
                    mrubyc/src/mrblib.c
                    mrubyc/src/rrt0.c
                    mrubyc/src/symbol.c
                    mrubyc/src/value.c
                    mrubyc/src/vm.c)

target_include_directories(app PRIVATE ${CMAKE_CURRENT_SOURCE_DIR}/src/lib/mrubyc ${CMAKE_CURRENT_SOURCE_DIR}/mrubyc/src)
```

## prj.conf
```kconfig
#
# Copyright (c) 2021 Nordic Semiconductor
#
# SPDX-License-Identifier: LicenseRef-Nordic-5-Clause
#

####################
# Build
####################
CONFIG_CPP=n
CONFIG_DEBUG_OPTIMIZATIONS=n
CONFIG_SIZE_OPTIMIZATIONS=y
CONFIG_PICOLIBC=y
CONFIG_TIMEOUT_64BIT=n
CONFIG_FPU=y
CONFIG_COMPILER_OPT="-DMRBC_SCHEDULER_EXIT=1 -DMRBC_USE_FLOAT=1 -DMRBC_USE_MATH=1 -DMAX_VM_COUNT=5" # mruby/c VM settings

####################
# Bluetooth LE
####################
CONFIG_BT=y
CONFIG_BT_PERIPHERAL=y
CONFIG_BT_DEVICE_NAME="OpenBlink"
CONFIG_BT_DEVICE_NAME_DYNAMIC=y
CONFIG_BT_CTLR_TX_PWR_PLUS_8=y
CONFIG_BT_SETTINGS=y
CONFIG_BT_MAX_CONN=1
CONFIG_BT_MAX_PAIRED=1

# Security Manager Protocol
CONFIG_BT_SMP=y
CONFIG_BT_SMP_SC_PAIR_ONLY=n

CONFIG_BT_BONDABLE=n
CONFIG_BT_CENTRAL=n
CONFIG_BT_GATT_DYNAMIC_DB=y
CONFIG_BT_ATT_PREPARE_COUNT=2
CONFIG_BT_PRIVACY=y
CONFIG_BT_CTLR_PRIVACY=y
CONFIG_BT_TRANSMIT_POWER_CONTROL=y
CONFIG_BT_SCA_UPDATE=y

CONFIG_BT_USER_DATA_LEN_UPDATE=y
CONFIG_BT_USER_PHY_UPDATE=y
CONFIG_BT_GAP_AUTO_UPDATE_CONN_PARAMS=n

CONFIG_NET_BUF=y
CONFIG_STREAM_FLASH=y

# MTU exchange is handled directly in ble.c using bt_gatt_exchange_mtu()
CONFIG_BT_L2CAP_TX_MTU=498
CONFIG_BT_BUF_ACL_TX_SIZE=251
CONFIG_BT_BUF_ACL_RX_SIZE=502
CONFIG_BT_CTLR_DATA_LENGTH_MAX=251

CONFIG_BT_CTLR_PHY_2M=y
CONFIG_BT_CTLR_PHY_CODED=y
CONFIG_BT_CTLR_SDC_MAX_CONN_EVENT_LEN_DEFAULT=4000000

CONFIG_BT_GATT_CLIENT=y
CONFIG_BT_GATT_DM=y

####################
# Flash (ZMS storage, Settings storage)
####################
CONFIG_FLASH=y
CONFIG_FLASH_PAGE_LAYOUT=y
CONFIG_FLASH_MAP=y
CONFIG_ZMS=y
CONFIG_ZMS_DATA_CRC=y
CONFIG_SETTINGS=y
CONFIG_SETTINGS_ZMS=y
CONFIG_SETTINGS_ZMS_CUSTOM_SECTOR_COUNT=y
CONFIG_SETTINGS_ZMS_SECTOR_COUNT=8

####################
# Drivers and peripherals
####################
CONFIG_GPIO=y
CONFIG_SPI=y
CONFIG_LED_STRIP=y
CONFIG_WS2812_STRIP_SPI=y
CONFIG_REBOOT=y
CONFIG_CRC=y

####################
# Clock
####################
CONFIG_CLOCK_CONTROL_NRF_K32SRC_RC=y
CONFIG_CLOCK_CONTROL_NRF_K32SRC_XTAL=n
CONFIG_CLOCK_CONTROL_NRF_K32SRC_500PPM=y
CONFIG_CLOCK_CONTROL_NRF_K32SRC_SYNTH=n

####################
# Thread
####################
CONFIG_TIMESLICING=y
CONFIG_TIMESLICE_SIZE=10
CONFIG_TIMESLICE_PRIORITY=0

####################
# Memory protection
####################
CONFIG_ARM_MPU=y
CONFIG_THREAD_STACK_INFO=y
CONFIG_THREAD_CUSTOM_DATA=n

####################
# Security
####################
CONFIG_NRF_APPROTECT_USE_UICR=y
#CONFIG_NRF_APPROTECT_LOCK=y

####################
# HW ID
####################
CONFIG_HWINFO=y
CONFIG_HWINFO_NRF=y
CONFIG_HW_ID_LIBRARY=y
CONFIG_HW_ID_LIBRARY_SOURCE_DEVICE_ID=y

####################
# Version
# $ west bindesc dump build/merged.hex
# https://docs.zephyrproject.org/latest/develop/west/zephyr-cmds.html#west-bindesc
####################
CONFIG_BINDESC=y
CONFIG_BINDESC_DEFINE=y
CONFIG_BINDESC_DEFINE_VERSION=y
CONFIG_BINDESC_APP_VERSION_MAJOR=y
CONFIG_BINDESC_APP_VERSION_MINOR=y
CONFIG_BINDESC_APP_VERSION_PATCHLEVEL=y
CONFIG_BINDESC_APP_VERSION_STRING=y
CONFIG_BINDESC_DEFINE_BUILD_TIME=n
CONFIG_BINDESC_BUILD_DATE_TIME_STRING=n
CONFIG_BINDESC_BUILD_TIME_ALWAYS_REBUILD=n
CONFIG_BINDESC_KERNEL_VERSION_STRING=y
CONFIG_BINDESC_KERNEL_VERSION_MAJOR=y
CONFIG_BINDESC_KERNEL_VERSION_MINOR=y
CONFIG_BINDESC_KERNEL_VERSION_PATCHLEVEL=y
CONFIG_BOOT_BANNER=n
CONFIG_BOOT_DELAY=0

#########################
# DEBUG
####################
CONFIG_DEBUG=y
CONFIG_CONSOLE=y
CONFIG_UART_CONSOLE=n
CONFIG_STDOUT_CONSOLE=n
CONFIG_EARLY_CONSOLE=y
CONFIG_RTT_CONSOLE=y
CONFIG_USE_SEGGER_RTT=y
CONFIG_SEGGER_RTT_BUFFER_SIZE_UP=2048
CONFIG_PRINTK=y
#CONFIG_PRINTK_SYNC=y
CONFIG_REQUIRES_FLOAT_PRINTF=y
CONFIG_CBPRINTF_NANO=n
CONFIG_CBPRINTF_LIBC_SUBSTS=n

####################
# Logging
####################
CONFIG_LOG=y
CONFIG_LOG_MODE_MINIMAL=y
#CONFIG_LOG_MODE_DEFERRED=n
#CONFIG_LOG_MODE_IMMEDIATE=n
#CONFIG_LOG_MODE_OVERFLOW=y

CONFIG_LOG_OVERRIDE_LEVEL=0
# - 0 OFF, do not override
# - 1 ERROR, override to write LOG_LEVEL_ERR
# - 2 WARNING, override to write LOG_LEVEL_WRN
# - 3 INFO, override to write LOG_LEVEL_INFO
# - 4 DEBUG, override to write LOG_LEVEL_DBG

#########################
# Thread analyzer
####################
#CONFIG_THREAD_ANALYZER=y
#CONFIG_THREAD_ANALYZER_USE_PRINTK=y
#CONFIG_THREAD_ANALYZER_AUTO=y
#CONFIG_THREAD_ANALYZER_AUTO_INTERVAL=5
#CONFIG_THREAD_NAME=y

####################
# Disable Bluetooth features not needed
####################
#CONFIG_BT_DEBUG_NONE=y
#CONFIG_BT_ASSERT=n
#CONFIG_BT_DATA_LEN_UPDATE=n
#CONFIG_BT_PHY_UPDATE=n
#CONFIG_BT_GATT_CACHING=n
#CONFIG_BT_GATT_SERVICE_CHANGED=n
#CONFIG_BT_GAP_PERIPHERAL_PREF_PARAMS=n
#CONFIG_BT_SETTINGS_CCC_LAZY_LOADING=y
#CONFIG_BT_HCI_VS_EXT=n
CONFIG_BT_GATT_READ_MULTIPLE=n
CONFIG_BT_GATT_READ_MULT_VAR_LEN=n
CONFIG_BT_CTLR_LE_PING=n
CONFIG_BT_ATT_RETRY_ON_SEC_ERR=n
CONFIG_BT_GATT_AUTO_RESUBSCRIBE=n
CONFIG_BT_GATT_ENFORCE_SUBSCRIPTION=n

####################
# Reduce Bluetooth buffers
####################
#CONFIG_BT_BUF_EVT_DISCARDABLE_COUNT=1
#CONFIG_BT_BUF_EVT_DISCARDABLE_SIZE=43
#CONFIG_BT_BUF_EVT_RX_COUNT=2
#CONFIG_BT_CONN_TX_MAX=2
#CONFIG_BT_L2CAP_TX_BUF_COUNT=2
#CONFIG_BT_BUF_ACL_TX_COUNT=3
#CONFIG_BT_BUF_ACL_TX_SIZE=27
```

## src/main.c
```c
/*
 * SPDX-License-Identifier: BSD-3-Clause
 * SPDX-FileCopyrightText: Copyright (c) 2025 ViXion Inc. All Rights Reserved.
 */
/**
 * @file main.c
 * @brief Main entry point for the OpenBlink firmware
 * @details This file contains the main function and factory reset detection
 * logic
 */
#include <stdbool.h>
#include <stddef.h>
#include <stdint.h>
#include <stdlib.h>
#include <zephyr/kernel.h>
#include <zephyr/logging/log.h>

#include "app/init.h"
#include "drv/gpio.h"

LOG_MODULE_REGISTER(main, LOG_LEVEL_DBG);

/**
 * @brief Main function of the OpenBlink firmware
 *
 * @return EXIT_FAILURE if the program exits unexpectedly
 */
int main(void) {
  while (1) {
    k_msleep(1000);
  }
  return EXIT_FAILURE;
}
```
